## conf/bblayers.conf.sample
```bitbake
# POKY_BBLAYERS_CONF_VERSION is increased each time build/conf/bblayers.conf
# changes incompatibly
POKY_BBLAYERS_CONF_VERSION = "2"

BBPATH = "${TOPDIR}"
BBFILES ?= ""

BBLAYERS ?= " \
  ${HOME}/poky-scarthgap/meta \
  ${HOME}/poky-scarthgap/meta-poky \
  ${HOME}/poky-scarthgap/meta-openembedded/meta-oe \
  ${HOME}/poky-scarthgap/meta-openembedded/meta-networking \
  ${HOME}/poky-scarthgap/meta-openembedded/meta-perl \
  ${HOME}/poky-scarthgap/meta-openembedded/meta-python \
  ${HOME}/poky-scarthgap/meta-freescale \
  ${HOME}/poky-scarthgap/meta-qt6 \
  ${HOME}/imx7/meta-imx7 \
"
```

## conf/layer.conf
```bitbake
# We have a conf and classes directory, append to BBPATH
BBPATH .= ":${LAYERDIR}"

# We have a recipes directory, add to BBFILES
BBFILES += "${LAYERDIR}/recipes*/*/*.bb ${LAYERDIR}/recipes*/*/*.bbappend ${LAYERDIR}/images/*.bb"

BBFILE_COLLECTIONS += "meta-imx7"
BBFILE_PATTERN_meta-imx7 := "^${LAYERDIR}/"
BBFILE_PRIORITY_meta-imx7 = "16"

LAYERSERIES_COMPAT_meta-imx7 = "scarthgap"
```

## conf/local.conf.sample
```bitbake
# Local configuration for meta-imx7 images
# Only tested with the NXP imx7ulp eval board
# Yocto Project 5.1 Poky distribution [styhead] branch

DISTRO_FEATURES = "ext2 opengl systemd usbhost ${DISTRO_FEATURES_LIBC}"

DISTRO_FEATURES_BACKFILL_CONSIDERED += "pulseaudio sysvinit"

DISTRO_FEATURES:remove = "ptest"

INIT_MANAGER = "systemd"

EXTRA_IMAGEDEPENDS += "virtual/bootloader"

IMAGE_ROOTFS_SIZE = "4194304"

# this is the default from meta-freescale
IMAGE_FSTYPES = "wic.bmap wic.gz"

MACHINE = "imx7ulpevk"

# the default is linux-fslc
PREFERRED_PROVIDER_virtual/kernel = "linux-stable"

#DL_DIR = "/src/styhead"
#SSTATE_DIR = "/oe5/imx7/sstate-cache"
#TMPDIR = "/oe5/imx7/tmp"

DISTRO = "poky"
PACKAGE_CLASSES = "package_ipk"

SDKMACHINE = "x86_64"

EXTRA_IMAGE_FEATURES = "debug-tweaks"

PATCHRESOLVE = "noop"
RM_OLD_IMAGE = "1"
INHERIT += "rm_work"
CONF_VERSION = "2"
```
